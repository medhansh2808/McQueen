## esp32/kachow_esp32_ap_v2/main/Kconfig.projbuild
```kconfig
menu "Kachow direct hotspot configuration"

config MCQUEEN_AP_SSID
    string "Car hotspot SSID"
    default "KACHOW-CAR"

config MCQUEEN_AP_PASSWORD
    string "Car hotspot password"
    default "kachow123"

config MCQUEEN_AP_CHANNEL
    int "Wi-Fi channel"
    range 1 13
    default 6

config MCQUEEN_UDP_PORT
    int "UDP control port"
    range 1 65535
    default 5007

config MCQUEEN_CONTROL_TOKEN
    string "Private control token"
    default "rc-car"

endmenu
```

## esp32/kachow_esp32_ap_v2/sdkconfig.defaults
```kconfig
CONFIG_ESPTOOLPY_FLASHSIZE_4MB=y
CONFIG_ESP_MAIN_TASK_STACK_SIZE=4096
CONFIG_FREERTOS_HZ=1000
```
